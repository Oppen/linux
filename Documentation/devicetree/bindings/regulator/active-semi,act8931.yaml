## Documentation/devicetree/bindings/regulator/active-semi,act8931.yaml
```yaml
# SPDX-License-Identifier: (GPL-2.0-only OR BSD-2-Clause)
%YAML 1.2
---
$id: http://devicetree.org/schemas/regulator/active-semi,act8931.yaml#
$schema: http://devicetree.org/meta-schemas/core.yaml#

title: Active-semi ACT8931 power management unit

maintainers:
  - Sergei Khomenkov <shomenkow@gmail.com>

description: |
  The ACT8931 has three step-down converters (DCDC1-3), four LDOs (LDO1-4)
  and a linear battery charger, controlled over I2C. The DCDC converters
  have two output voltage registers, VSET1 and VSET2; the VSEL pin selects
  which one is in effect. All seven outputs take a 6-bit selector:
  0.6 V + 25 mV steps (0-23), 1.2 V + 50 mV steps (24-47) and 2.4 V +
  100 mV steps (48-63).

  The register map is the ACT8865's regulator part plus the ACT8945A's
  charger status registers, without the suspend set-point registers of
  those parts. The charge current is set by pins (ISET, CHGLEV, ACIN).

properties:
  compatible:
    const: active-semi,act8931

  reg:
    maxItems: 1

  interrupts:
    maxItems: 1
    description:
      The nIRQ output (open drain, active low).

  active-semi,vsel-high:
    description:
      Indicates the VSEL pin is high, so the VSET2 registers set the DCDC
      outputs. If this property is missing, the VSEL pin is assumed to be
      low.
    type: boolean

  regulators:
    type: object
    additionalProperties: false
    description:
      The outputs. DCDC_REG1-3 are the step-down converters, supplied from
      the VP1, VP2 and VP3 pins; LDO_REG1-4 are the LDOs, all supplied from
      the INL pin.

    properties:
      DCDC_REG1:
        type: object
        $ref: /schemas/regulator/regulator.yaml#
        unevaluatedProperties: false

        properties:
          vp1-supply:
            description: Handle to the VP1 input supply

      DCDC_REG2:
        type: object
        $ref: /schemas/regulator/regulator.yaml#
        unevaluatedProperties: false

        properties:
          vp2-supply:
            description: Handle to the VP2 input supply

      DCDC_REG3:
        type: object
        $ref: /schemas/regulator/regulator.yaml#
        unevaluatedProperties: false

        properties:
          vp3-supply:
            description: Handle to the VP3 input supply

    patternProperties:
      "^LDO_REG[1-4]$":
        type: object
        $ref: /schemas/regulator/regulator.yaml#
        unevaluatedProperties: false

        properties:
          inl-supply:
            description: Handle to the INL input supply

required:
  - compatible
  - reg

additionalProperties: false

examples:
  - |
    i2c {
      #address-cells = <1>;
      #size-cells = <0>;

      pmic@5b {
        compatible = "active-semi,act8931";
        reg = <0x5b>;
        active-semi,vsel-high;

        regulators {
          DCDC_REG1 {
            regulator-min-microvolt = <3400000>;
            regulator-max-microvolt = <3500000>;
          };

          DCDC_REG3 {
            regulator-min-microvolt = <1400000>;
            regulator-max-microvolt = <1400000>;
            regulator-always-on;
          };

          LDO_REG4 {
            regulator-min-microvolt = <3100000>;
            regulator-max-microvolt = <3100000>;
            regulator-always-on;
            regulator-boot-on;
          };
        };
      };
    };
```
